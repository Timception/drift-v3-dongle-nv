## boards/shields/drift/Kconfig.defconfig
```kconfig
if SHIELD_DRIFT_CENTRAL_DONGLE

config ZMK_KEYBOARD_NAME
    default "Drift V3 NV"

config ZMK_SPLIT_ROLE_CENTRAL
    default y

endif



if SHIELD_DRIFT_LEFT_CENTRAL

config ZMK_KEYBOARD_NAME
    default "Drift V3"

config ZMK_SPLIT_ROLE_CENTRAL
    default y

endif



if SHIELD_DRIFT_LEFT || SHIELD_DRIFT_RIGHT || SHIELD_DRIFT_CENTRAL_DONGLE || SHIELD_DRIFT_LEFT_CENTRAL

config ZMK_SPLIT
    default y

endif
```
